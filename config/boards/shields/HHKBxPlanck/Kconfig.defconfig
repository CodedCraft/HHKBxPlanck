## config/boards/shields/HHKBxPlanck/Kconfig.shield
```kconfig
# Copyright (c) 2020 The ZMK Contributors
# SPDX-License-Identifier: MIT

config SHIELD_HHKBXPLANCK
	def_bool $(shields_list_contains,HHKBxPlanck)
```
